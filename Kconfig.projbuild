## Kconfig.projbuild
```kconfig
menu "Board Selection"

choice
    prompt "Target board"
    default BOARD_7INCH

config BOARD_7INCH
    bool "Waveshare ESP32-S3 7 inch"

config BOARD_7INCH_TYPEB
    bool "Waveshare ESP32-S3 7 inch Type B"

config BOARD_5INCH
    bool "Waveshare ESP32-S3 5 inch"

config BOARD_3_5INCH
    bool "Waveshare ESP32-S3 3.5 inch"
endchoice

endmenu
```

## sdkconfig.defaults
```kconfig
CONFIG_PARTITION_TABLE_CUSTOM=y
CONFIG_PARTITION_TABLE_CUSTOM_FILENAME="partitions.csv"
CONFIG_PARTITION_TABLE_FILENAME="partitions.csv"
CONFIG_LVGL_TICK_PERIOD=5
CONFIG_LVGL_USE_LOG=y
CONFIG_LVGL_LOG_LEVEL_INFO=y
CONFIG_LVGL_MEM_POOL_SIZE=48
```
